## prj.conf
```kconfig
#
# Hardware settings
#

CONFIG_GPIO=y
CONFIG_NRFX_PDM=y
CONFIG_ADC=y

# To flash via dev board
#CONFIG_BUILD_OUTPUT_UF2=n
#CONFIG_USE_DT_CODE_PARTITION=n

#
# Bluetooth settings
#

CONFIG_BT=y
CONFIG_BT_PERIPHERAL=y
CONFIG_BT_DEVICE_NAME="Tanu"
CONFIG_BT_MAX_CONN=1
CONFIG_BT_MAX_PAIRED=1
CONFIG_BT_DEVICE_APPEARANCE=22
CONFIG_BT_GATT_DYNAMIC_DB=y

# CONFIG_BT_L2CAP_DYNAMIC_CHANNEL=y
# CONFIG_BT_SMP=y
# CONFIG_BT_LL_SW_SPLIT=y # Alternative implementation

# Battery and Device Information services
CONFIG_BT_BAS=y
CONFIG_BT_DIS=y
CONFIG_BT_DIS_PNP=n
CONFIG_BT_DIS_MODEL="Tanu"
CONFIG_BT_DIS_MANUF="Based Hardware"
CONFIG_BT_DIS_FW_REV=y
CONFIG_BT_DIS_HW_REV=y
CONFIG_BT_DIS_FW_REV_STR="1.0.4"
CONFIG_BT_DIS_HW_REV_STR="Seeed Xiao BLE Sense"

# Large packets
CONFIG_BT_L2CAP_TX_MTU=498
CONFIG_BT_L2CAP_TX_BUF_COUNT=10
# CONFIG_BT_ATT_TX_COUNT=10
CONFIG_BT_CONN_TX_MAX=30
CONFIG_BT_BUF_ACL_RX_SIZE=2048
CONFIG_BT_BUF_ACL_TX_SIZE=2048
CONFIG_BT_CTLR_DATA_LENGTH_MAX=251

CONFIG_BT_USER_DATA_LEN_UPDATE=y
CONFIG_BT_AUTO_DATA_LEN_UPDATE=y
CONFIG_BT_USER_PHY_UPDATE=y
CONFIG_BT_AUTO_PHY_UPDATE=y

# Codecs
# CONFIG_LIBLC3=y

# Debug
# CONFIG_DEBUG=y
# CONFIG_ASSERT=y
# CONFIG_LOG=y
# CONFIG_LOG_PRINTK=y
# CONFIG_LOG_BUFFER_SIZE=4096
# CONFIG_LOG_PROCESS_THREAD_STACK_SIZE=4096
# CONFIG_LOG_MODE_IMMEDIATE=y

# Log Levels
# CONFIG_BT_DEBUG_LOG=y
# CONFIG_BT_L2CAP_LOG_LEVEL_DBG=y
# CONFIG_BT_LOG_LEVEL_DBG=y

# CONFIG_LOG_PROCESS_THREAD_STACK_SIZE=4096
# CONFIG_BT_RX_STACK_SIZE=4096
# CONFIG_BT_CTLR_RX_PRIO_STACK_SIZE=4096
# CONFIG_BT_DEBUG_LOG=y
# CONFIG_LOG_BUFFER_SIZE=32000
# CONFIG_LOG_OVERRIDE_LEVEL=4
# CONFIG_LOG_PROCESS_THREAD_STACK_SIZE=4096
# CONFIG_BT_RX_STACK_SIZE=4096
# CONFIG_BT_CTLR_RX_PRIO_STACK_SIZE=4096

# RTT
# CONFIG_UART_CONSOLE=n
# CONFIG_SEGGER_RTT_BUFFER_SIZE_UP=2048
# CONFIG_RTT_CONSOLE=y
# CONFIG_LOG_BACKEND_RTT=y
CONFIG_CODEC_OPUS=y
```

## src/main.c
```c
#include <zephyr/kernel.h>
#include "transport.h"
#include "mic.h"
#include "utils.h"
#include "led.h"
#include "config.h"
#include "audio.h"
#include "codec.h"

static void codec_handler(uint8_t *data, size_t len)
{
	broadcast_audio_packets(data, len); // Errors are logged inside
}

static void mic_handler(int16_t *buffer)
{
	codec_receive_pcm(buffer, MIC_BUFFER_SAMPLES); // Errors are logged inside
}

void bt_ctlr_assert_handle(char *name, int type)
{
	if (name != NULL)
	{
		printk("Bt assert-> %s", name);
	}
}

bool is_connected = false;

void set_led_state()
{
	// Disconnected - RED
	if (!is_connected)
	{
		set_led_red(true);
		set_led_green(false);
		set_led_blue(false);
		return;
	}

	// Connected and talking - GREEN
	if (transport_is_streaming() && voice_is_active())
	{
		set_led_red(false);
		set_led_green(true);
		set_led_blue(false);
		return;
	}

	// Connected but silent / not listening - BLUE
	set_led_red(false);
	set_led_green(false);
	set_led_blue(true);
}

// Main loop
int main(void)
{
	// Led start
	ASSERT_OK(led_start());
	set_led_blue(true);

	// Transport start
	ASSERT_OK(transport_start());

	// Codec start
	set_codec_callback(codec_handler);
	ASSERT_OK(codec_start());

	// Mic start
	set_mic_callback(mic_handler);
	ASSERT_OK(mic_start());

	while (1)
	{
		set_led_state();
		k_msleep(100);
	}

	// Unreachable
	return 0;
}
```

## src/codec.c
```c
#include <zephyr/sys/ring_buffer.h>
#include "codec.h"
#include "audio.h"
#include "config.h"
#include "utils.h"
#ifdef CODEC_OPUS
#include "lib/opus-1.2.1/opus.h"
#endif

//
// Output
//

static volatile codec_callback _callback = NULL;

void set_codec_callback(codec_callback callback)
{
    _callback = callback;
}

//
// Input
//

uint8_t codec_ring_buffer_data[AUDIO_BUFFER_SAMPLES * 2]; // 2 bytes per sample
struct ring_buf codec_ring_buf;

int codec_receive_pcm(int16_t *data, size_t len)
{
    int written = ring_buf_put(&codec_ring_buf, (uint8_t *)data, len * 2);
    if (written != len * 2)
    {
        printk("Failed to write %d bytes to codec ring buffer\n", len * 2);
        return -1;
    }
    return 0;
}

//
// Thread
//

int16_t codec_input_samples[CODEC_PACKAGE_SAMPLES];
uint8_t codec_output_bytes[CODEC_OUTPUT_MAX_BYTES];
K_THREAD_STACK_DEFINE(codec_stack, 32000);
static struct k_thread codec_thread;
uint16_t execute_codec();

#if CODEC_OPUS
#if (CONFIG_OPUS_MODE == CONFIG_OPUS_MODE_CELT)
#define OPUS_ENCODER_SIZE 7180
#endif
#if (CONFIG_OPUS_MODE == CONFIG_OPUS_MODE_HYBRID)
#define OPUS_ENCODER_SIZE 10916
#endif
__ALIGN(4)
static uint8_t m_opus_encoder[OPUS_ENCODER_SIZE];
static OpusEncoder *const m_opus_state = (OpusEncoder *)m_opus_encoder;
#endif

static volatile int64_t last_voice_ms = 0;

static bool frame_has_voice(int16_t *samples, size_t n)
{
    // RMS energy check: less sensitive to single-sample spikes than a
    // pure peak threshold. Compares mean square against threshold^2 to
    // avoid sqrt() on the MCU.
    int64_t sum_sq = 0;
    for (size_t i = 0; i < n; i++)
    {
        int32_t s = samples[i];
        sum_sq += (int64_t)s * (int64_t)s;
    }
    int64_t mean_sq = sum_sq / (int64_t)n;
    int64_t thresh_sq = (int64_t)VOICE_RMS_THRESHOLD * (int64_t)VOICE_RMS_THRESHOLD;
    return mean_sq > thresh_sq;
}

bool voice_is_active(void)
{
    if (last_voice_ms == 0)
    {
        return false;
    }
    return (k_uptime_get() - last_voice_ms) <= VOICE_HANGOVER_MS;
}

void codec_entry()
{
    uint16_t output_size;
    while (1)
    {

        // Check if we have enough data
        if (ring_buf_size_get(&codec_ring_buf) < CODEC_PACKAGE_SAMPLES * 2)
        {
            k_sleep(K_MSEC(10));
            continue;
        }

        // Read package
        ring_buf_get(&codec_ring_buf, (uint8_t *)codec_input_samples, CODEC_PACKAGE_SAMPLES * 2);

        // Voice activity check before encoding
        if (frame_has_voice(codec_input_samples, CODEC_PACKAGE_SAMPLES))
        {
            last_voice_ms = k_uptime_get();
        }

        // Run Codec
        output_size = execute_codec();

        // Notify
        if (_callback)
        {
            _callback(codec_output_bytes, output_size);
        }

        // Yield
        k_yield();
    }
}

int codec_start()
{
    
// OPUS
#if CODEC_OPUS
    ASSERT_TRUE(opus_encoder_get_size(1) == sizeof(m_opus_encoder));
    ASSERT_TRUE(opus_encoder_init(m_opus_state, 16000, 1, CODEC_OPUS_APPLICATION) == OPUS_OK);
    ASSERT_TRUE(opus_encoder_ctl(m_opus_state, OPUS_SET_BITRATE(CODEC_OPUS_BITRATE)) == OPUS_OK);
    ASSERT_TRUE(opus_encoder_ctl(m_opus_state, OPUS_SET_VBR(CODEC_OPUS_VBR)) == OPUS_OK);
    ASSERT_TRUE(opus_encoder_ctl(m_opus_state, OPUS_SET_VBR_CONSTRAINT(0)) == OPUS_OK);
    ASSERT_TRUE(opus_encoder_ctl(m_opus_state, OPUS_SET_COMPLEXITY(CODEC_OPUS_COMPLEXITY)) == OPUS_OK);
    ASSERT_TRUE(opus_encoder_ctl(m_opus_state, OPUS_SET_SIGNAL(OPUS_SIGNAL_VOICE)) == OPUS_OK);
    ASSERT_TRUE(opus_encoder_ctl(m_opus_state, OPUS_SET_LSB_DEPTH(16)) == OPUS_OK);
    ASSERT_TRUE(opus_encoder_ctl(m_opus_state, OPUS_SET_DTX(0)) == OPUS_OK);
    ASSERT_TRUE(opus_encoder_ctl(m_opus_state, OPUS_SET_INBAND_FEC(0)) == OPUS_OK);
    ASSERT_TRUE(opus_encoder_ctl(m_opus_state, OPUS_SET_PACKET_LOSS_PERC(0)) == OPUS_OK);
#endif

    // Thread
    ring_buf_init(&codec_ring_buf, sizeof(codec_ring_buffer_data), codec_ring_buffer_data);
    k_thread_create(&codec_thread, codec_stack, K_THREAD_STACK_SIZEOF(codec_stack), (k_thread_entry_t)codec_entry, NULL, NULL, NULL, K_PRIO_PREEMPT(4), 0, K_NO_WAIT);

    // Success
    return 0;
}

//
// MU-Law codec
//

#if CODEC_MU_LAW

uint16_t execute_codec()
{
    for (int i = 0; i < CODEC_PACKAGE_SAMPLES / CODEC_DIVIDER; i++)
    {
        codec_output_bytes[i] = linear2ulaw(codec_input_samples[i * CODEC_DIVIDER]);
    }
    return CODEC_PACKAGE_SAMPLES / CODEC_DIVIDER;
}

#endif

//
// PCM codec
//

#if CODEC_PCM

uint16_t execute_codec()
{
    for (int i = 0; i < CODEC_PACKAGE_SAMPLES / CODEC_DIVIDER; i++)
    {
        codec_output_bytes[i * 2] = codec_input_samples[i * CODEC_DIVIDER] & 0xFF;
        codec_output_bytes[i * 2 + 1] = (codec_input_samples[i * CODEC_DIVIDER] >> 8) & 0xFF;
    }
    return (CODEC_PACKAGE_SAMPLES / CODEC_DIVIDER) * 2;
}
#endif

//
// Opus codec
//

#if CODEC_OPUS

uint16_t execute_codec()
{
    opus_int32 size = opus_encode(m_opus_state, codec_input_samples, CODEC_PACKAGE_SAMPLES, codec_output_bytes, sizeof(codec_output_bytes));
    if (size < 0)
    {
        printk("Opus encoding failed: %d\n", size);
        return 0;
    }
    // printk("Opus encoding success: %i\n", size);
    return size;
}

#endif
```

## src/codec.h
```c
#pragma once
#include <zephyr/kernel.h>
#include <stdbool.h>

// Callback
typedef void (*codec_callback)(uint8_t *data, size_t len);
void set_codec_callback(codec_callback callback);

// Integration
int codec_receive_pcm(int16_t *data, size_t len);
int codec_start();
bool voice_is_active(void);
```

## src/config.h
```c
#include <haly/nrfy_gpio.h>

// #define SAMPLE_RATE 16000
#define MIC_GAIN 64
#define MIC_IRC_PRIORITY 7
#define MIC_BUFFER_SAMPLES 1600    // 100ms
#define AUDIO_BUFFER_SAMPLES 16000 // 1s
#define NETWORK_RING_BUF_SIZE 32   // number of frames * CODEC_OUTPUT_MAX_BYTES
#define MINIMAL_PACKET_SIZE 100    // Less than that doesn't make sence to send anything at all

// PIN definitions
// https://github.com/Seeed-Studio/Adafruit_nRF52_Arduino/blob/5aa3573913449410fd60f76b75673c53855ff2ec/variants/Seeed_XIAO_nRF52840_Sense/variant.cpp#L34
#define PDM_DIN_PIN NRF_GPIO_PIN_MAP(0, 16)
#define PDM_CLK_PIN NRF_GPIO_PIN_MAP(1, 0)
#define PDM_PWR_PIN NRF_GPIO_PIN_MAP(1, 10)

// Codecs
// #define CODEC_PCM 1
// #define CODEC_MU_LAW 1
#define CODEC_OPUS 1

// Codec packages
#if CODEC_PCM | CODEC_MU_LAW
#define CODEC_DIVIDER 2           // 1 or 2
#define CODEC_PACKAGE_SAMPLES 160 // 10ms
#if CODEC_PCM
#define CODEC_OUTPUT_MAX_BYTES CODEC_PACKAGE_SAMPLES * 2
#else
#define CODEC_OUTPUT_MAX_BYTES CODEC_PACKAGE_SAMPLES
#endif
#endif

#if CODEC_OPUS
#define CODEC_PACKAGE_SAMPLES 160
#define CODEC_OUTPUT_MAX_BYTES CODEC_PACKAGE_SAMPLES * 2 // Let's assume that 16bit is enough
#define CODEC_OPUS_APPLICATION OPUS_APPLICATION_RESTRICTED_LOWDELAY
#define CODEC_OPUS_BITRATE 32000
#define CODEC_OPUS_VBR 1 // Or 1
#define CODEC_OPUS_COMPLEXITY 3
#endif
#define CONFIG_OPUS_MODE CONFIG_OPUS_MODE_CELT

// Voice detection (RMS threshold per 10ms frame)
#define VOICE_RMS_THRESHOLD 350
#define VOICE_HANGOVER_MS 1000

// Codec IDs
#ifdef CODEC_PCM
#if CODEC_DIVIDER == 1
#define CODEC_ID 0
#elif CODEC_DIVIDER == 2
#define CODEC_ID 1
#endif
#endif

#ifdef CODEC_MU_LAW
#if CODEC_DIVIDER == 1
#define CODEC_ID 10
#elif CODEC_DIVIDER == 2
#define CODEC_ID 11
#endif
#endif

#ifdef CODEC_OPUS
#define CODEC_ID 20
#endif

// Logs
// #define LOG_DISCARDED
```

## src/transport.c
```c
#include <zephyr/kernel.h>
#include <zephyr/logging/log.h>
#include <zephyr/sys/ring_buffer.h>
#include <zephyr/bluetooth/bluetooth.h>
#include <zephyr/bluetooth/uuid.h>
#include <zephyr/bluetooth/gatt.h>
#include <zephyr/bluetooth/l2cap.h>
#include <zephyr/bluetooth/services/bas.h>
#include <zephyr/sys/atomic.h>
#include <zephyr/drivers/gpio.h>
#include "transport.h"
#include "config.h"
#include "utils.h"
#include "btutils.h"
#include "lib/battery/battery.h"

extern bool is_connected;

//
// Internal
//

static struct bt_conn_cb _callback_references;

static void audio_ccc_config_changed_handler(const struct bt_gatt_attr *attr, uint16_t value);
static ssize_t audio_data_read_characteristic(struct bt_conn *conn, const struct bt_gatt_attr *attr, void *buf, uint16_t len, uint16_t offset);
static ssize_t audio_codec_read_characteristic(struct bt_conn *conn, const struct bt_gatt_attr *attr, void *buf, uint16_t len, uint16_t offset);

static void dfu_ccc_config_changed_handler(const struct bt_gatt_attr *attr, uint16_t value);
static ssize_t dfu_control_point_write_handler(struct bt_conn *conn, const struct bt_gatt_attr *attr, const void *buf, uint16_t len, uint16_t offset, uint8_t flags);

//
// Service and Characteristic
//

// Audio service with UUID 19B10000-E8F2-537E-4F6C-D104768A1214
// exposes following characteristics:
// - Audio data (UUID 19B10001-E8F2-537E-4F6C-D104768A1214) to send audio data (read/notify)
// - Audio codec (UUID 19B10002-E8F2-537E-4F6C-D104768A1214) to send audio codec type (read)
// TODO: The current audio service UUID seems to come from old Intel sample code,
// we should change it to UUID 814b9b7c-25fd-4acd-8604-d28877beee6d
static struct bt_uuid_128 audio_service_uuid = BT_UUID_INIT_128(BT_UUID_128_ENCODE(0x19B10000, 0xE8F2, 0x537E, 0x4F6C, 0xD104768A1214));
static struct bt_uuid_128 audio_characteristic_data_uuid = BT_UUID_INIT_128(BT_UUID_128_ENCODE(0x19B10001, 0xE8F2, 0x537E, 0x4F6C, 0xD104768A1214));
static struct bt_uuid_128 audio_characteristic_format_uuid = BT_UUID_INIT_128(BT_UUID_128_ENCODE(0x19B10002, 0xE8F2, 0x537E, 0x4F6C, 0xD104768A1214));

static struct bt_gatt_attr audio_service_attr[] = {
    BT_GATT_PRIMARY_SERVICE(&audio_service_uuid),
    BT_GATT_CHARACTERISTIC(&audio_characteristic_data_uuid.uuid, BT_GATT_CHRC_READ | BT_GATT_CHRC_NOTIFY, BT_GATT_PERM_READ, audio_data_read_characteristic, NULL, NULL),
    BT_GATT_CCC(audio_ccc_config_changed_handler, BT_GATT_PERM_READ | BT_GATT_PERM_WRITE),
    BT_GATT_CHARACTERISTIC(&audio_characteristic_format_uuid.uuid, BT_GATT_CHRC_READ, BT_GATT_PERM_READ, audio_codec_read_characteristic, NULL, NULL),
};

static struct bt_gatt_service audio_service = BT_GATT_SERVICE(audio_service_attr);

// Nordic Legacy DFU service with UUID 00001530-1212-EFDE-1523-785FEABCD123
// exposes following characteristics:
// - Control point (UUID 00001531-1212-EFDE-1523-785FEABCD123) to start the OTA update process (write/notify)
static struct bt_uuid_128 dfu_service_uuid = BT_UUID_INIT_128(BT_UUID_128_ENCODE(0x00001530, 0x1212, 0xEFDE, 0x1523, 0x785FEABCD123));
static struct bt_uuid_128 dfu_control_point_uuid = BT_UUID_INIT_128(BT_UUID_128_ENCODE(0x00001531, 0x1212, 0xEFDE, 0x1523, 0x785FEABCD123));

static struct bt_gatt_attr dfu_service_attr[] = {
    BT_GATT_PRIMARY_SERVICE(&dfu_service_uuid),
    BT_GATT_CHARACTERISTIC(&dfu_control_point_uuid.uuid, BT_GATT_CHRC_WRITE | BT_GATT_CHRC_NOTIFY, BT_GATT_PERM_WRITE, NULL, dfu_control_point_write_handler, NULL),
    BT_GATT_CCC(dfu_ccc_config_changed_handler, BT_GATT_PERM_READ | BT_GATT_PERM_WRITE),
};

static struct bt_gatt_service dfu_service = BT_GATT_SERVICE(dfu_service_attr);

// Advertisement data
static const struct bt_data bt_ad[] = {
    BT_DATA_BYTES(BT_DATA_FLAGS, (BT_LE_AD_GENERAL | BT_LE_AD_NO_BREDR)),
    BT_DATA(BT_DATA_UUID128_ALL, audio_service_uuid.val, sizeof(audio_service_uuid.val)),
    BT_DATA(BT_DATA_NAME_COMPLETE, "Tanu", sizeof("Tanu") - 1),
};

// Scan response data
static const struct bt_data bt_sd[] = {
    BT_DATA_BYTES(BT_DATA_UUID16_ALL, BT_UUID_16_ENCODE(BT_UUID_DIS_VAL)),
    BT_DATA(BT_DATA_UUID128_ALL, dfu_service_uuid.val, sizeof(dfu_service_uuid.val)),
};

//
// State and Characteristics
//

struct bt_conn *current_connection = NULL;
uint16_t current_mtu = 0;
uint16_t current_package_index = 0;

#define STREAMING_TIMEOUT_MS 1500
static volatile bool audio_subscribed = false;
static volatile int64_t last_notify_ms = 0;

static void audio_ccc_config_changed_handler(const struct bt_gatt_attr *attr, uint16_t value)
{
    if (value == BT_GATT_CCC_NOTIFY)
    {
        audio_subscribed = true;
        printk("Client subscribed for notifications\n");
    }
    else if (value == 0)
    {
        audio_subscribed = false;
        printk("Client unsubscribed from notifications\n");
    }
    else
    {
        printk("Invalid CCC value: %u\n", value);
    }
}

static ssize_t audio_data_read_characteristic(struct bt_conn *conn, const struct bt_gatt_attr *attr, void *buf, uint16_t len, uint16_t offset)
{
    printk("audio_data_read_characteristic\n");
    return bt_gatt_attr_read(conn, attr, buf, len, offset, NULL, 0);
}

static ssize_t audio_codec_read_characteristic(struct bt_conn *conn, const struct bt_gatt_attr *attr, void *buf, uint16_t len, uint16_t offset)
{
    printk("audio_codec_read_characteristic\n");
    uint8_t value[1] = {CODEC_ID};
    return bt_gatt_attr_read(conn, attr, buf, len, offset, value, sizeof(value));
}

//
// DFU Service Handlers
//

static void dfu_ccc_config_changed_handler(const struct bt_gatt_attr *attr, uint16_t value)
{
    if (value == BT_GATT_CCC_NOTIFY)
    {
        printk("Client subscribed for notifications\n");
    }
    else if (value == 0)
    {
        printk("Client unsubscribed from notifications\n");
    }
    else
    {
        printk("Invalid CCC value: %u\n", value);
    }
}

static ssize_t dfu_control_point_write_handler(struct bt_conn *conn, const struct bt_gatt_attr *attr, const void *buf, uint16_t len, uint16_t offset, uint8_t flags)
{
    printk("dfu_control_point_write_handler\n");
    if (len == 1 && ((uint8_t *)buf)[0] == 0x06)
    {
        NRF_POWER->GPREGRET = 0xA8;
        NVIC_SystemReset();
    }
    else if (len == 2 && ((uint8_t *)buf)[0] == 0x01)
    {
        uint8_t notification_value = 0x10;
        bt_gatt_notify(conn, attr, &notification_value, sizeof(notification_value));

        NRF_POWER->GPREGRET = 0xA8;
        NVIC_SystemReset();
    }
    return len;
}

//
// Battery Service Handlers
//

#define BATTERY_REFRESH_INTERVAL 15000 // 15 seconds

void broadcast_battery_level(struct k_work *work_item);

K_WORK_DELAYABLE_DEFINE(battery_work, broadcast_battery_level);

void broadcast_battery_level(struct k_work *work_item) {
    uint16_t battery_millivolt;
    uint8_t battery_percentage;

    if (battery_get_millivolt(&battery_millivolt) == 0 &&
        battery_get_percentage(&battery_percentage, battery_millivolt) == 0) {

        printk("Battery at %d mV (capacity %d%%)\n", battery_millivolt, battery_percentage);

        // Use the Zephyr BAS function to set (and notify) the battery level
        int err = bt_bas_set_battery_level(battery_percentage);
        if (err) {
            printk("Error updating battery level: %d\n", err);
        }
    } else {
        printk("Failed to read battery level\n");
    }

    k_work_reschedule(&battery_work, K_MSEC(BATTERY_REFRESH_INTERVAL));
}

//
// Connection Callbacks
//

static void _transport_connected(struct bt_conn *conn, uint8_t err)
{
    struct bt_conn_info info = {0};

    err = bt_conn_get_info(conn, &info);
    if (err)
    {
        printk("Failed to get connection info (err %d)\n", err);
        return;
    }

    current_connection = bt_conn_ref(conn);
    current_mtu = info.le.data_len->tx_max_len;
    printk("Connected\n");
    printk("Interval: %d, latency: %d, timeout: %d\n", info.le.interval, info.le.latency, info.le.timeout);
    printk("TX PHY %s, RX PHY %s\n", phy2str(info.le.phy->tx_phy), phy2str(info.le.phy->rx_phy));
    printk("LE data len updated: TX (len: %d time: %d) RX (len: %d time: %d)\n", info.le.data_len->tx_max_len, info.le.data_len->tx_max_time, info.le.data_len->rx_max_len, info.le.data_len->rx_max_time);

    k_work_schedule(&battery_work, K_MSEC(BATTERY_REFRESH_INTERVAL));

    is_connected = true;
}

static void _transport_disconnected(struct bt_conn *conn, uint8_t err)
{
    is_connected = false;
    audio_subscribed = false;
    last_notify_ms = 0;

    printk("Disconnected\n");
    bt_conn_unref(conn);
    current_connection = NULL;
    current_mtu = 0;
}

static bool _le_param_req(struct bt_conn *conn, struct bt_le_conn_param *param)
{
    printk("Connection parameters update request received.\n");
    printk("Minimum interval: %d, Maximum interval: %d\n",
           param->interval_min, param->interval_max);
    printk("Latency: %d, Timeout: %d\n", param->latency, param->timeout);

    return true;
}

static void _le_param_updated(struct bt_conn *conn, uint16_t interval,
                              uint16_t latency, uint16_t timeout)
{
    printk("Connection parameters updated.\n"
           " interval: %d, latency: %d, timeout: %d\n",
           interval, latency, timeout);
}

static void _le_phy_updated(struct bt_conn *conn,
                            struct bt_conn_le_phy_info *param)
{
    printk("LE PHY updated: TX PHY %s, RX PHY %s\n",
           phy2str(param->tx_phy), phy2str(param->rx_phy));
}

static void _le_data_length_updated(struct bt_conn *conn,
                                    struct bt_conn_le_data_len_info *info)
{
    printk("LE data len updated: TX (len: %d time: %d)"
           " RX (len: %d time: %d)\n",
           info->tx_max_len,
           info->tx_max_time, info->rx_max_len, info->rx_max_time);
    current_mtu = info->tx_max_len;
}

static struct bt_conn_cb _callback_references = {
    .connected = _transport_connected,
    .disconnected = _transport_disconnected,
    .le_param_req = _le_param_req,
    .le_param_updated = _le_param_updated,
    .le_phy_updated = _le_phy_updated,
    .le_data_len_updated = _le_data_length_updated,
};

//
// Ring Buffer
//

#define NET_BUFFER_HEADER_SIZE 3
#define RING_BUFFER_HEADER_SIZE 2
static uint8_t tx_queue[NETWORK_RING_BUF_SIZE * (CODEC_OUTPUT_MAX_BYTES + RING_BUFFER_HEADER_SIZE)];
static uint8_t tx_buffer[CODEC_OUTPUT_MAX_BYTES + RING_BUFFER_HEADER_SIZE];
static uint8_t tx_buffer_2[CODEC_OUTPUT_MAX_BYTES + RING_BUFFER_HEADER_SIZE];
static uint32_t tx_buffer_size = 0;
static struct ring_buf ring_buf;

static bool write_to_tx_queue(uint8_t *data, size_t size)
{
    if (size > CODEC_OUTPUT_MAX_BYTES)
    {
        return false;
    }

    // Copy data (TODO: Avoid this copy)
    tx_buffer_2[0] = size & 0xFF;
    tx_buffer_2[1] = (size >> 8) & 0xFF;
    memcpy(tx_buffer_2 + RING_BUFFER_HEADER_SIZE, data, size);

    // Write to ring buffer
    int written = ring_buf_put(&ring_buf, tx_buffer_2, (CODEC_OUTPUT_MAX_BYTES + RING_BUFFER_HEADER_SIZE)); // It always fits completely or not at all
    if (written != CODEC_OUTPUT_MAX_BYTES + RING_BUFFER_HEADER_SIZE)
    {
        return false;
    }
    else
    {
        return true;
    }
}

static void drop_oldest_tx_frame(void)
{
    uint8_t discard[CODEC_OUTPUT_MAX_BYTES + RING_BUFFER_HEADER_SIZE];
    ring_buf_get(&ring_buf, discard, sizeof(discard));
}

static uint32_t dropped_tx_frames = 0;

static bool read_from_tx_queue()
{

    // Read from ring buffer
    // memset(tx_buffer, 0, sizeof(tx_buffer));
    tx_buffer_size = ring_buf_get(&ring_buf, tx_buffer, (CODEC_OUTPUT_MAX_BYTES + RING_BUFFER_HEADER_SIZE)); // It always fits completely or not at all
    if (tx_buffer_size != (CODEC_OUTPUT_MAX_BYTES + RING_BUFFER_HEADER_SIZE))
    {
        printk("Failed to read from ring buffer %d\n", tx_buffer_size);
        return false;
    }

    // Adjust size
    tx_buffer_size = tx_buffer[0] + (tx_buffer[1] << 8);

    return true;
}

//
// Pusher
//

// Thread
K_THREAD_STACK_DEFINE(pusher_stack, 1024);
static struct k_thread pusher_thread;
static uint16_t packet_next_index = 0;
static uint8_t pusher_temp_data[CODEC_OUTPUT_MAX_BYTES + NET_BUFFER_HEADER_SIZE];

static bool push_to_gatt(struct bt_conn *conn)
{
    // Read data from ring buffer
    if (!read_from_tx_queue())
    {
        return false;
    }

    // Push each frame
    // Effective payload is limited by both link-layer tx len and GATT ATT MTU.
    uint16_t att_mtu = bt_gatt_get_mtu(conn);
    uint16_t effective_mtu = MIN(current_mtu, att_mtu);
    if (effective_mtu <= NET_BUFFER_HEADER_SIZE)
    {
        return false;
    }
    uint32_t max_payload = effective_mtu - NET_BUFFER_HEADER_SIZE;
    uint16_t frame_id = packet_next_index++;
    uint8_t *buffer = tx_buffer + RING_BUFFER_HEADER_SIZE;
    uint32_t offset = 0;
    uint8_t index = 0;
    while (offset < tx_buffer_size)
    {
        // Recombine packet: same frame_id for all fragments of one
        // codec frame, frag index marks the order. A new frame starts
        // with index 0 so the client can find frame boundaries.
        uint32_t packet_size = MIN(max_payload, tx_buffer_size - offset);
        pusher_temp_data[0] = frame_id & 0xFF;
        pusher_temp_data[1] = (frame_id >> 8) & 0xFF;
        pusher_temp_data[2] = index;
        memcpy(pusher_temp_data + NET_BUFFER_HEADER_SIZE, buffer + offset, packet_size);
        offset += packet_size;
        index++;

        while (true)
        {
            // Try send notification
            int err = bt_gatt_notify(conn, &audio_service.attrs[1], pusher_temp_data, packet_size + NET_BUFFER_HEADER_SIZE);

            if (err == 0)
            {
                last_notify_ms = k_uptime_get();
            }
            else
            {
                printk("bt_gatt_notify failed (err %d)\n", err);
                printk("MTU: %d, packet_size: %d\n", current_mtu, packet_size + NET_BUFFER_HEADER_SIZE);
                k_sleep(K_MSEC(1));
            }

            // Try to send more data if possible
            if (err == -EAGAIN || err == -ENOMEM)
            {
                continue;
            }

            // Break if success
            break;
        }
    }

    return true;
}

void pusher(void)
{
    while (1)
    {

        //
        // Load current connection
        //

        struct bt_conn *conn = current_connection;
        bool use_gatt = true;
        if (conn)
        {
            conn = bt_conn_ref(conn);
        }
        bool valid = true;
        if (current_mtu < MINIMAL_PACKET_SIZE)
        {
            valid = false;
        }
        else if (!conn)
        {
            valid = false;
        }
        else
        {
            valid = bt_gatt_is_subscribed(conn, &audio_service.attrs[1], BT_GATT_CCC_NOTIFY); // Check if subscribed
        }

        // If no valid mode exists - discard whole buffer
        if (!valid)
        {
            ring_buf_reset(&ring_buf);
            k_sleep(K_MSEC(10));
        }

        // Handle GATT
        if (use_gatt && valid)
        {
            bool sent = push_to_gatt(conn);
            if (!sent)
            {
                k_sleep(K_MSEC(50));
            }
            else
            {
                k_yield();
            }
        }

        if (conn)
        {
            bt_conn_unref(conn);
        }
    }
}

//
// Public functions
//

int transport_start()
{
    // Configure callbacks
    bt_conn_cb_register(&_callback_references);

    // Enable Bluetooth
    int err = bt_enable(NULL);
    if (err)
    {
        printk("Bluetooth init failed (err %d)\n", err);
        return err;
    }
    printk("Bluetooth initialized\n");

    // Start advertising
    bt_gatt_service_register(&audio_service);
    bt_gatt_service_register(&dfu_service);
    err = bt_le_adv_start(BT_LE_ADV_CONN, bt_ad, ARRAY_SIZE(bt_ad), bt_sd, ARRAY_SIZE(bt_sd));
    if (err)
    {
        printk("Advertising failed to start (err %d)\n", err);
        return err;
    }
    else
    {
        printk("Advertising successfully started\n");
    }

     int battErr = 0;

	battErr |= battery_init();
	battErr |= battery_charge_start();

	if (battErr)
	{
		 printk("Battery init failed (err %d)\n", battErr);
	}
	else
	{
		  printk("Battery initialized\n");
	}

    // Start pusher
    ring_buf_init(&ring_buf, sizeof(tx_queue), tx_queue);
    k_thread_create(&pusher_thread, pusher_stack, K_THREAD_STACK_SIZEOF(pusher_stack), (k_thread_entry_t)pusher, NULL, NULL, NULL, K_PRIO_PREEMPT(7), 0, K_NO_WAIT);

    // Start battery reporting even before a connection exists; the
    // handler reschedules itself and bt_bas_set_battery_level() simply
    // fails while disconnected.
    k_work_schedule(&battery_work, K_MSEC(1000));

    return 0;
}

struct bt_conn *get_current_connection()
{
    return current_connection;
}

bool transport_is_streaming(void)
{
    if (current_connection == NULL)
    {
        return false;
    }
    if (!audio_subscribed)
    {
        return false;
    }
    if (current_mtu < MINIMAL_PACKET_SIZE)
    {
        return false;
    }
    if (last_notify_ms == 0)
    {
        return false;
    }
    if ((k_uptime_get() - last_notify_ms) > STREAMING_TIMEOUT_MS)
    {
        return false;
    }
    return true;
}

int broadcast_audio_packets(uint8_t *buffer, size_t size)
{
    // Non-blocking: if the queue is full, drop the oldest frame to make
    // room instead of stalling the codec thread forever.
    if (!write_to_tx_queue(buffer, size))
    {
        drop_oldest_tx_frame();
        dropped_tx_frames++;
#ifdef LOG_DISCARDED
        printk("TX queue full, dropped frame %u\n", dropped_tx_frames);
#endif
        if (!write_to_tx_queue(buffer, size))
        {
            return -ENOMEM;
        }
    }
    return 0;
}
```

## src/transport.h
```c
#pragma once
#include <zephyr/kernel.h>
#include <stdbool.h>
int transport_start();
int broadcast_audio_packets(uint8_t *buffer, size_t size);
bool transport_is_streaming(void);
```
